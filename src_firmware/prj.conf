## Kconfig
```
# SPDX-License-Identifier: Apache-2.0
#
# Copyright (c) 2023 Maciej Baczmanski, Michal Kawiak, Jakub Mazur
#

menu "Motor controller configuration"
config GEARSHIFT_RATIO
	int "Gearshift ratio of attached motor"
	default 150

config ENC_STEPS_PER_ROTATION
	int "Number of encoder steps per one full rotation"
	default 64

config ENC_TIMER_PERIOD_MS
	int "Sampling period for continuus speed and position calculation"
	default 100

config TEMPLATE_NAME_SIZE
	int "Max size of template's name in characters"
	default 10

config SPEED_MAX_MRPM
	int "Max motor speed from motor documentation (in mili RPM - one thousands of RPM)"
	default 67000

config POSITION_CONTROL_MODIFIER
	int "Accuracy of position control (if value is 10 position is controlled in deca-degrees; \
	     if 100 - centi-degrees etc.)"
	default 10

config UART_SHELL_SUPPORT
	bool "Support for communication using uart shell - set to one to communicate via shell \
	      over uart, 0 for disabled communication"
	default y

config BT_SUPPORT
	bool "bool value, 1 if BLE is supposed to be supported, 0 if not"
	#BLE
	select BT
	select BT_SMP
	select BT_PERIPHERAL
	select BT_DIS
	select BT_DIS_PNP

config SUPPORTED_CHANNEL_NUMBER
	int "number of channels supported by the hardware"
	default 2

config KP_NUMERATOR_FOR_SPEED
	int "proportional part numerator for speed control"
	default 4

config KP_DENOMINATOR_FOR_SPEED
	int "proportional part denominator for speed control"
	default 10

if UART_SHELL_SUPPORT
config USB_DEVICE_VID
	default 0x1915

config USB_DEVICE_PID
	default 0x0000
endif

if BT_SUPPORT
config BT_DEVICE_NAME
	default "Motor Controller"

config BT_DEVICE_APPEARANCE
	default 833
endif

endmenu

source "Kconfig.zephyr"
```

## prj.conf
```kconfig
# SPDX-License-Identifier: Apache-2.0
#
# Copyright (c) 2023 Maciej Baczmanski, Michal Kawiak, Jakub Mazur
#

CONFIG_ASSERT=y
CONFIG_SHELL=y

CONFIG_GPIO=y
CONFIG_PWM=y
CONFIG_PWM_SHELL=n

# For Printk()
CONFIG_PRINTK=y
CONFIG_CONSOLE=y

#NVS
CONFIG_FLASH=y
CONFIG_FLASH_PAGE_LAYOUT=y

CONFIG_NVS=y
CONFIG_MPU_ALLOW_FLASH_WRITE=y
CONFIG_UART_SHELL_SUPPORT=y
CONFIG_BT_SUPPORT=y

CONFIG_SUPPORTED_CHANNEL_NUMBER=1
```

## src/ble_gatt.c
```c
// SPDX-License-Identifier: Apache-2.0
// Copyright (c) 2023 Maciej Baczmanski, Michal Kawiak, Jakub Mazur
// Copyright (c) 2016 Intel Corporation
#if defined(CONFIG_BT_SUPPORT)

#include "driver.h"

#include <zephyr/kernel.h>
#include <zephyr/bluetooth/gatt.h>

static char ble_buff[8];

static ssize_t read_ble(struct bt_conn *conn, const struct bt_gatt_attr *attr,
			 void *buf, uint16_t len, uint16_t offset)
{
	return bt_gatt_attr_read(conn, attr, buf, len, offset, &ble_buff,
				 sizeof(ble_buff));
}

uint32_t convertToUint32(uint8_t *bytes)
{
	uint32_t result = 0;

	memcpy(&result, bytes, 4U);

	// swap endianness
	result = ((result << 8) & 0xFF00FF00) | ((result >> 8) & 0xFF00FF);
	return (result << 16) | (result >> 16);
}

static ssize_t write_ble(struct bt_conn *conn, const struct bt_gatt_attr *attr,
			 const void *buf, uint16_t len, uint16_t offset, uint8_t flag)
{
	uint8_t *data = (uint8_t *)buf;

	if (len == 1) {
		if (data[0] == 0) {
			init_pwm_motor_driver();
		}
	#if defined(CONFIG_BOARD_NRF52840DONGLE_NRF52840)

		else if (data[0] == 1) {
			enter_boot();
		}
	#endif
		else if (data[0] == 2) {
			uint32_t speed_tmp = speed_target_get();

			memcpy(ble_buff, &speed_tmp, sizeof(speed_tmp));

		} else if (data[0] == 3) {
			const struct DriverVersion tmp_ver = get_driver_version();

			memcpy(ble_buff, &tmp_ver, 2U);
		}
		return len;
	} else if (len == 5) {
		target_speed_set(convertToUint32(data+1U), CH0);
	}
	return len;
}


BT_GATT_SERVICE_DEFINE(hrs_svc,
	BT_GATT_PRIMARY_SERVICE(BT_UUID_HRS),
	BT_GATT_CHARACTERISTIC(BT_UUID_HRS_BODY_SENSOR, BT_GATT_CHRC_READ,
			       BT_GATT_PERM_READ,
			       read_ble, NULL, NULL),
	BT_GATT_CHARACTERISTIC(BT_UUID_HRS_CONTROL_POINT, BT_GATT_CHRC_WRITE,
			       BT_GATT_PERM_WRITE,
			       NULL, write_ble, NULL),
);

#endif
```

## src/driver.c
```c
// SPDX-License-Identifier: Apache-2.0
// Copyright (c) 2023 Maciej Baczmanski, Michal Kawiak, Jakub Mazur

#include <zephyr/drivers/gpio.h>
#include <zephyr/drivers/pwm.h>
#include <zephyr/types.h>
#include <string.h>
#include "driver.h"

static const struct DriverVersion driver_ver = {
	.major = 2,
	.minor = 0,
};

/// temporary debug only variables: - To be deleted after developemnt is finished!
uint64_t count_timer;
static int32_t ret_debug = 100;// DEBUG ONLY

#pragma region InternalFunctions// declarations of internal functions
// They shouldn't be moved to .h file, their scope is only for .c file
static void enc_callback_ch0(const struct device *dev, struct gpio_callback *cb, uint32_t pins);
#if (CONFIG_SUPPORTED_CHANNEL_NUMBER > 1)
static void enc_callback_ch1(const struct device *dev, struct gpio_callback *cb, uint32_t pins);
#endif
static int speed_pwm_set(uint32_t value);
static void update_speed_and_position_continuus(struct k_work *work);
static void continuus_calculation_timer_handler(struct k_timer *dummy);
static void enc_callback(enum ChannelNumber chnl);
#pragma endregion InternalFunctions

/// Unit conversion defines
#define MIN_TO_MS 60000
#define RPM_TO_MRPM 1000

/// CONTROL MODE - whether speed or position is controlled
static enum ControlModes control_mode = SPEED;
/// encoder timer - timer is common for both channels
struct k_timer continuus_calculation_timer;
/// driver initialized (Was init function called)?
static bool drv_initialised;

// Struct representing singular channel, including channel - dependent variables
struct DriverChannel {
	/// PINS definitions
	/// motor out
	const struct pwm_dt_spec pwm_motor_driver;
	const struct gpio_dt_spec set_dir_pins[2];
	/// enc in
	const struct gpio_dt_spec enc_pins[2];
	struct gpio_callback enc_cb[2];

	/// ENCODER - variables used for actual speed calculation based on encoder pin and
	// timer interrupts
	uint64_t count_cycles;
	uint64_t old_count_cycles;

	/// SPEED control
	uint32_t target_speed_mrpm;// Target set by user
	uint32_t actual_mrpm; // actual speed calculated from encoder pins
	uint32_t speed_control; // PID output -> pwm calculations input

	/// POSITION control
	uint32_t curr_pos;
	uint32_t target_position;

	int32_t position_delta;//TEMP

	const uint32_t max_pos;

	void (*enc_callback_ptr)(const struct device *dev, struct gpio_callback *cb, uint32_t pins);

	/// BOOLS - is motor on?
	bool is_motor_on; // was motor_on function called?
};
static struct DriverChannel drv_chnls[CONFIG_SUPPORTED_CHANNEL_NUMBER] = {
	{
		.max_pos = 360u * CONFIG_POSITION_CONTROL_MODIFIER,
		.pwm_motor_driver = PWM_DT_SPEC_GET(DT_ALIAS(pwm_drv_ch1)),
		.set_dir_pins[P0] = GPIO_DT_SPEC_GET(DT_ALIAS(set_dir_p1_ch1), gpios),
		.set_dir_pins[P1] = GPIO_DT_SPEC_GET(DT_ALIAS(set_dir_p2_ch1), gpios),
		.enc_pins[P0] = GPIO_DT_SPEC_GET(DT_ALIAS(get_enc_p1_ch1), gpios),
		.enc_pins[P1] = GPIO_DT_SPEC_GET(DT_ALIAS(get_enc_p2_ch1), gpios),
		.enc_callback_ptr = &enc_callback_ch0 // TODO - turn all callbacks to one function!
	}
};

#if defined(CONFIG_BOARD_NRF52840DONGLE_NRF52840) // BOOT functionality
static const struct gpio_dt_spec out_boot = GPIO_DT_SPEC_GET(DT_ALIAS(enter_boot_p), gpios);
void enter_boot(void)
{
	gpio_pin_configure_dt(&out_boot, GPIO_OUTPUT);
}
#endif

// function implementations:
#pragma region TimerWorkCallback // timer interrupt internal functions
static void update_speed_and_position_continuus(struct k_work *work)
{
	for (unsigned int chnl = 0; chnl < CONFIG_SUPPORTED_CHANNEL_NUMBER; ++chnl) {
		count_timer += 1; // debug only

		// TODO - move declarations to global scope for efficiency (or make them static?)

		uint64_t diff = 0;

		// count encoder interrupts between timer interrupts:
		if (drv_chnls[chnl].count_cycles > drv_chnls[chnl].old_count_cycles) {
			diff = drv_chnls[chnl].count_cycles - drv_chnls[chnl].old_count_cycles;
		}
		drv_chnls[chnl].old_count_cycles = drv_chnls[chnl].count_cycles;

		// calculate actual position
		int32_t pos_diff = (diff*drv_chnls[chnl].max_pos) /
				   (CONFIG_ENC_STEPS_PER_ROTATION * CONFIG_GEARSHIFT_RATIO);
		int32_t new_pos = (int32_t)drv_chnls[CH0].curr_pos + pos_diff;

		if (new_pos <= 0) {
			drv_chnls[chnl].curr_pos = (uint32_t)(drv_chnls[chnl].max_pos + new_pos);
		} else {
			drv_chnls[chnl].curr_pos = ((uint32_t)new_pos)%(drv_chnls[chnl].max_pos);
		}

		// calculate actual speed
		drv_chnls[chnl].actual_mrpm = RPM_TO_MRPM * MIN_TO_MS * diff /
			(CONFIG_ENC_STEPS_PER_ROTATION *
			CONFIG_GEARSHIFT_RATIO *
			CONFIG_ENC_TIMER_PERIOD_MS);

		// if motor is on, calculate control value
		if (get_motor_off_on(chnl)) {
			int ret;

			if (control_mode == SPEED) {
				int32_t speed_delta = drv_chnls[chnl].target_speed_mrpm -
						      drv_chnls[chnl].actual_mrpm;

				int64_t temp_modifier_num = CONFIG_KP_NUMERATOR_FOR_SPEED *
							    speed_delta;
				int32_t temp_modifier = (int32_t)(temp_modifier_num /
								  CONFIG_KP_DENOMINATOR_FOR_SPEED);

				// increase or decrese speed each iteration by Kp * speed_delta
				drv_chnls[chnl].speed_control = (uint32_t)
								(drv_chnls[chnl].speed_control +
								 temp_modifier);

				// Cap control at max rpm speed,
				// to avoid cumulation of too high speeds.
				if (drv_chnls[chnl].speed_control > CONFIG_SPEED_MAX_MRPM) {
					drv_chnls[chnl].speed_control = CONFIG_SPEED_MAX_MRPM;
				}

				ret = speed_pwm_set(drv_chnls[chnl].speed_control);
			} else if (control_mode == POSITION) {
				// TODO - it is temporary version of position control -
				// - will be improved!
				// TODO - control it in BOTH direction, currently
				// it goes only forward
				drv_chnls[chnl].position_delta = drv_chnls[chnl].target_position -
								 drv_chnls[chnl].curr_pos;

				if (drv_chnls[chnl].position_delta < 0) {
					drv_chnls[chnl].position_delta =
					-drv_chnls[chnl].position_delta;
				}

				if (drv_chnls[chnl].position_delta >
						drv_chnls[CH0].max_pos/(36)) {
					//36 - control precision, TODO -
					// possibly decrease the value?
					drv_chnls[chnl].target_speed_mrpm = CONFIG_SPEED_MAX_MRPM/3;
					/*
					 * CONFIG_SPEED_MAX_MRPM/3 is temporary,
					 * TODO - make this value dependent on position_delta,
					 * further the target, move faster
					 */
				} else {
					drv_chnls[chnl].target_speed_mrpm = 0;
				}
				ret_debug = speed_pwm_set(drv_chnls[chnl].target_speed_mrpm);
			}
		}
	}
}
K_WORK_DEFINE(speed_and_position_update_work, update_speed_and_position_continuus);
static void continuus_calculation_timer_handler(struct k_timer *dummy)
{
	k_work_submit(&speed_and_position_update_work);
}
K_TIMER_DEFINE(continuus_calculation_timer, continuus_calculation_timer_handler, NULL);
#pragma endregion TimerWorkCallback


// TODO - turn all encoder callbacks to one function!
// encoder functions
static void enc_callback(enum ChannelNumber chnl)
{
	drv_chnls[chnl].count_cycles += 1;// TODO - add directionality calculation
}
static void enc_callback_ch0(const struct device *dev, struct gpio_callback *cb, uint32_t pins)
{
	enc_callback(CH0);
}
#if (CONFIG_SUPPORTED_CHANNEL_NUMBER > 1)
static void enc_callback_ch1(const struct device *dev, struct gpio_callback *cb, uint32_t pins)
{
	enc_callback(CH1);
}
#endif


// init motor
int init_pwm_motor_driver(void)
{
	int ret;

	for (unsigned int channel = 0; channel < CONFIG_SUPPORTED_CHANNEL_NUMBER; channel++) {

		if (!device_is_ready(drv_chnls[channel].pwm_motor_driver.dev)) {
			return PWM_DRV_NOT_READY;
		}

		ret = pwm_set_pulse_dt(&(drv_chnls[channel].pwm_motor_driver), 0);

		if (ret != 0) {
			return UNABLE_TO_SET_PWM_CHNL1;
		}


		if (!gpio_is_ready_dt(&(drv_chnls[channel].set_dir_pins[P0]))) {
			return GPIO_OUT_DIR_CNTRL_NOT_READY;
		}

		ret = gpio_pin_configure_dt(&(drv_chnls[channel].set_dir_pins[P0]),
					    GPIO_OUTPUT_LOW);
		if (ret != 0) {
			return UNABLE_TO_SET_GPIO;
		}

		// TODO - move to function
		if (!gpio_is_ready_dt(&(drv_chnls[channel].set_dir_pins[P1]))) {
			return GPIO_OUT_DIR_CNTRL_NOT_READY;
		}
		ret = gpio_pin_configure_dt(&(drv_chnls[channel].set_dir_pins[P1]),
					    GPIO_OUTPUT_LOW);


		if (ret != 0) {
			return UNABLE_TO_SET_GPIO;
		}

	#if defined(CONFIG_BOARD_NRF52840DONGLE_NRF52840)
		if (!gpio_is_ready_dt(&out_boot)) {
			return GPIO_OUT_BOOT_NOT_READY;
		}
	#endif

		for (int i = 0; i < 2; ++i) {
			ret = gpio_pin_configure_dt(&(drv_chnls[channel].enc_pins[i]), GPIO_INPUT);
			ret = gpio_pin_interrupt_configure_dt(&(drv_chnls[channel].enc_pins[i]),
							      GPIO_INT_EDGE_BOTH);
			gpio_init_callback(&(drv_chnls[channel].enc_cb[i]),
					   *(drv_chnls[channel].enc_callback_ptr),
					   BIT(drv_chnls[channel].enc_pins[i].pin));
			gpio_add_callback(drv_chnls[channel].enc_pins[i].port,
					  &(drv_chnls[channel].enc_cb[i]));
			// TODO - ret error checking!!
		}

	}

	k_timer_start(&continuus_calculation_timer, K_MSEC(CONFIG_ENC_TIMER_PERIOD_MS),
		      K_MSEC(CONFIG_ENC_TIMER_PERIOD_MS));

	drv_initialised = true;

	return SUCCESS;
}

// Motor off/on functions
int motor_on(enum MotorDirection direction, enum ChannelNumber chnl)
{
	int ret;

	if (!drv_initialised) {
		return NOT_INITIALISED;
	}

	// TODO - change direction during spinning

	if (drv_chnls[chnl].is_motor_on) {
		// Motor is already on, no need for starting it again
		return SUCCESS;
	}

	drv_chnls[chnl].speed_control = 0;
	drv_chnls[chnl].count_cycles = 0;
	drv_chnls[chnl].old_count_cycles = 0;
	if (direction == FORWARD) {
		ret = gpio_pin_set_dt(&(drv_chnls[chnl].set_dir_pins[0]), 1);
		if (ret != 0) {
			return UNABLE_TO_SET_GPIO;
		}
		ret = gpio_pin_set_dt(&(drv_chnls[chnl].set_dir_pins[1]), 0);
		if (ret != 0) {
			return UNABLE_TO_SET_GPIO;
		}
	} else if (direction == BACKWARD) {
		ret = gpio_pin_set_dt(&(drv_chnls[chnl].set_dir_pins[0]), 0);
		if (ret != 0) {
			return UNABLE_TO_SET_GPIO;
		}
		ret = gpio_pin_set_dt(&(drv_chnls[chnl].set_dir_pins[1]), 1);
		if (ret != 0) {
			return UNABLE_TO_SET_GPIO;
		}
	}

	drv_chnls[chnl].is_motor_on = true;
	return SUCCESS;
}
int motor_off(enum ChannelNumber chnl)
{
	int ret;

	if (!drv_initialised) {
		return NOT_INITIALISED;
	}

	if (!drv_chnls[chnl].is_motor_on) {
		// Motor is already off, no need for stopping it again
		return SUCCESS;
	}

	if (drv_initialised) {
		ret = gpio_pin_set_dt(&(drv_chnls[chnl].set_dir_pins[P0]), 0);

		if (ret != 0) {
			return UNABLE_TO_SET_GPIO;
		}
		ret = gpio_pin_set_dt(&(drv_chnls[chnl].set_dir_pins[P1]), 0);
		if (ret != 0) {
			return UNABLE_TO_SET_GPIO;
		}
		drv_chnls[chnl].is_motor_on = false;
		return SUCCESS;
	}

	return NOT_INITIALISED;
}
bool get_motor_off_on(enum ChannelNumber chnl)
{
	return drv_chnls[chnl].is_motor_on;
}

// Speed control functions
static int speed_pwm_set(uint32_t value)
{
	int ret;

	if (!drv_initialised) {
		return NOT_INITIALISED;
	}

	if (value > CONFIG_SPEED_MAX_MRPM) {
		return DESIRED_VALUE_TO_HIGH;
	}

	if (drv_chnls[CH0].target_speed_mrpm < CONFIG_SPEED_MAX_MRPM/10) {
		value = 0;
		drv_chnls[CH0].speed_control = 0;
	}

	uint64_t w_1 = drv_chnls[CH0].pwm_motor_driver.period * (uint64_t)value;
	uint32_t w = value != 0 ? (uint32_t)(w_1/CONFIG_SPEED_MAX_MRPM) : 0;

	ret = pwm_set_pulse_dt(&(drv_chnls[CH0].pwm_motor_driver), w);
	if (ret != 0) {
		return UNABLE_TO_SET_PWM_CHNL1;
	}

	return SUCCESS;
}
int target_speed_set(uint32_t value, enum ChannelNumber chnl)
{
	if (control_mode != SPEED) {
		return UNSUPPORTED_FUNCTION_IN_CURRENT_MODE;
	}
	drv_chnls[chnl].target_speed_mrpm = value;
	drv_chnls[chnl].count_cycles = 0;
	drv_chnls[chnl].old_count_cycles = 0;
	return SUCCESS;
}
int speed_get(enum ChannelNumber chnl, uint32_t *value)
{
	if (drv_initialised) {
		*value = drv_chnls[chnl].actual_mrpm; // TODO - get speed from encoder
		return SUCCESS;
	}

	return NOT_INITIALISED;
}
uint32_t speed_target_get(void)
{
	return drv_chnls[CH0].target_speed_mrpm;
}
uint32_t get_current_max_speed(void)
{
	return CONFIG_SPEED_MAX_MRPM;
}

// position control functions
int target_position_set(uint32_t new_target_position, enum ChannelNumber chnl)
{
	if (!drv_initialised) {
		return NOT_INITIALISED;
	}

	if (control_mode != POSITION) {
		return UNSUPPORTED_FUNCTION_IN_CURRENT_MODE;
	}

	drv_chnls[chnl].target_position = new_target_position;
	return SUCCESS;
}
int position_get(uint32_t *value, enum ChannelNumber chnl)
{
	if (!drv_initialised) {
		return NOT_INITIALISED;
	}

	*value = drv_chnls[chnl].curr_pos;
	return SUCCESS;
}

// Mode is channel-independent
int mode_set(enum ControlModes new_mode)
{
	if (!drv_initialised) {
		return NOT_INITIALISED;
	}

	control_mode = new_mode;
	return SUCCESS;
}
int mode_get(enum ControlModes *value)
{
	if (!drv_initialised) {
		return NOT_INITIALISED;
	}

	*value = control_mode;
	return SUCCESS;
}
int get_control_mode_from_string(char *str_control_mode, enum ControlModes *ret_value)
{
	if (strcmp(str_control_mode, "speed") == 0) {
		*ret_value = SPEED;
		return SUCCESS;
	} else if (strcmp(str_control_mode, "position") == 0 ||
		  strcmp(str_control_mode, "pos") == 0) {

		*ret_value = POSITION;
		return SUCCESS;
	} else {
		return VALUE_CONVERSION_ERROR;
	}
}
int get_control_mode_as_string(enum ControlModes control_mode, char **ret_value)
{
	if (control_mode == SPEED) {
		*ret_value = "Speed";
		return SUCCESS;
	} else if (control_mode == POSITION) {
		*ret_value = "Position";
		return SUCCESS;
	} else {
		return VALUE_CONVERSION_ERROR;
	}
}

#pragma region DebugFunctions
uint64_t get_cycles_count_DEBUG(void)
{
	return drv_chnls[CH0].count_cycles;
}

uint64_t get_time_cycles_count_DEBUG(void)
{
	return count_timer;
}

int32_t get_ret_DEBUG(void)
{
	return ret_debug;
}

uint32_t get_calc_speed_DEBUG(void)
{
	return drv_chnls[CH0].speed_control;
}

uint32_t get_target_pos_DEBUG(void)
{
	return drv_chnls[CH0].target_position;
}

int32_t get_pos_d_DEBUG(void)
{
	return drv_chnls[CH0].position_delta;
}
#pragma endregion DebugFunctions

struct DriverVersion get_driver_version(void)
{
	return driver_ver;
}
```

## src/driver.h
```c
/* SPDX-License-Identifier: Apache-2.0
 *
 * Copyright (c) 2023 Maciej Baczmanski, Michal Kawiak, Jakub Mazur
 */

#include <zephyr/kernel.h>



/// @brief Error code definitions for motor driver
enum error_codes {
	SUCCESS = 0,
	NOT_INITIALISED = 1,

	PWM_DRV_NOT_READY = 2,
	GPIO_OUT_DIR_CNTRL_NOT_READY = 3,
	GPIO_IN_ENC_NOT_READY = 4,
	GPIO_OUT_BOOT_NOT_READY = 5,
	UNABLE_TO_SET_PWM_CHNL1 = 6,

	DESIRED_VALUE_TO_HIGH = 7,

	UNABLE_TO_SET_GPIO = 8,

	UNSUPPORTED_FUNCTION_IN_CURRENT_MODE = 9,
	VALUE_CONVERSION_ERROR = 10
};

/// @brief motor direction definitions
enum MotorDirection {
	FORWARD,
	BACKWARD
};

/// @brief Control Mode - whether excact speed or position is controlled
enum ControlModes {
	SPEED,
	POSITION
};

/// @brief struct representing current software version
struct DriverVersion {
	uint8_t major;
	uint8_t minor;
};

enum ChannelNumber {
	CH0,
	CH1
};

// TODO add preprocessor check for max supported channels (currently only CH0 and CH1)

enum PinNumber {
	P0,
	P1
};


/// @brief Function initalising PWMs (drivers) and GPIOs.
/// @param speed_max_mrpm - max speed defined in mili RPM
/// @return error defined in error_codes
int init_pwm_motor_driver(void);

/// @brief Set new desired (targeted) speed AND set the pwm
/// @param value - value in mili RPM
/// @return error defined in error_codes
int target_speed_set(uint32_t value, enum ChannelNumber chnl);

/// @brief Get current actual speed (from encoders)  - TODO - implement with encoders
/// @param value - variable to save speed
/// @return error defined in error_codes
int speed_get(enum ChannelNumber chnl, uint32_t *value);

/// @brief Turn motor on in proper direction, without modyfing target speed or set pwm output.
/// @param direction - FORWARD or BACKWARD
/// @return error defined in error_codes
int motor_on(enum MotorDirection direction, enum ChannelNumber chnl);

/// @brief Turn motor off, without modyfing pwm output
/// @return error defined in error_codes
int motor_off(enum ChannelNumber chnl);

/// @brief Simple getter for max speed (set by init_pwm_motor_driver)
/// @return max speed in mili RPM
uint32_t get_current_max_speed(void);

/// @brief Simple getter for current motor state (off or on)
/// @return true - motor is on; false - motor is off
bool get_motor_off_on(enum ChannelNumber chnl);

/// @brief Simple getter for firmware software version
/// @return DriverVersion struct of major and minor version
struct DriverVersion get_driver_version(void);

/// @brief Simple getter for target speed set with target_speed_set function
/// @return uint32_t representing target speed.
uint32_t speed_target_get(void);

/// @brief utility function for converting control mode as string to control mode as proper enum
/// @param str_control_mode control mode as string
/// @param ret_value output - control mode as control mode enum
/// @return error defined in error_codes
int get_control_mode_from_string(char *str_control_mode, enum ControlModes *ret_value);

/// @brief utility function for converting control mode from enum to string
/// @param control_mode control mode as enum
/// @param ret_value output - control mode as string
/// @return error defined in error_codes
int get_control_mode_as_string(enum ControlModes control_mode, char **ret_value);

int target_position_set(uint32_t new_target_position, enum ChannelNumber chnl);

int position_get(uint32_t *value, enum ChannelNumber chnl);

int mode_set(enum ControlModes new_mode);

int mode_get(enum ControlModes *value);

#if defined(CONFIG_BOARD_NRF52840DONGLE_NRF52840)
/// @brief Enter bootloader mode (in order to flash new software via nRF connect programmer)
void enter_boot(void);
#endif

uint64_t get_cycles_count_DEBUG(void);
uint64_t get_time_cycles_count_DEBUG(void);
int32_t get_ret_DEBUG(void);
uint32_t get_calc_speed_DEBUG(void);
uint32_t get_target_pos_DEBUG(void);
int32_t get_pos_d_DEBUG(void);
```

## src/shell.c
```c
// SPDX-License-Identifier: Apache-2.0
// Copyright (c) 2023 Maciej Baczmanski, Michal Kawiak, Jakub Mazur
#if defined(CONFIG_UART_SHELL_SUPPORT)

#include <zephyr/kernel.h>
#include <zephyr/shell/shell.h>
#include <stdlib.h>
#include "driver.h"
#include "storage.h"


enum ChannelNumber relevant_channel = CH0;

static int cmd_channel(const struct shell *shell, size_t argc, char *argv[])
{
	if (argc == 1) {
		shell_fprintf(shell, SHELL_NORMAL, "relevant channel: %d\n", relevant_channel);
	} else if (argc == 2) {
		enum ChannelNumber new_channel = (enum ChannelNumber)strtol(argv[1], NULL, 10);

		if (new_channel >= CONFIG_SUPPORTED_CHANNEL_NUMBER) {
			shell_fprintf(shell, SHELL_NORMAL,
			"New channel %d higher than no of supported channels %d\n",
			new_channel, CONFIG_SUPPORTED_CHANNEL_NUMBER);
			return 0;
		}
		relevant_channel = new_channel;
		shell_fprintf(shell, SHELL_NORMAL, "channel set to: %d\n", relevant_channel);
	}
	return 0;
}

static int cmd_speed(const struct shell *shell, size_t argc, char *argv[])
{
	int ret;
	uint32_t speed_mrpm;

	if (argc == 1) {
		ret = speed_get(relevant_channel, &speed_mrpm);
		if (ret == SUCCESS) {
			shell_fprintf(shell, SHELL_NORMAL, "speed: %d\n", speed_mrpm);

		} else if (ret == NOT_INITIALISED) {
			shell_fprintf(shell, SHELL_ERROR,
				"driver not initialised, could't get speed!\n");

		} else {
			shell_fprintf(shell, SHELL_ERROR, "other error, code: %d\n", ret);
		}

		return 0;
	} else if (argc == 2) {
		speed_mrpm = (uint32_t)strtol(argv[1], NULL, 10);
		ret = target_speed_set(speed_mrpm, relevant_channel);

		if (ret == SUCCESS) {
			shell_fprintf(shell, SHELL_NORMAL, "speed set to: %d\n", speed_mrpm);

		} else if (ret == NOT_INITIALISED) {
			shell_fprintf(shell, SHELL_ERROR,
				"driver not initialised, could't set speed!\n");

		} else if (ret == DESIRED_VALUE_TO_HIGH) {
			shell_fprintf(shell, SHELL_ERROR,
				"Desired speed to high! Desired speed: %d; Max speed: %d\n",
				speed_mrpm, get_current_max_speed());

		} else if (ret == UNSUPPORTED_FUNCTION_IN_CURRENT_MODE) {
			shell_fprintf(shell, SHELL_ERROR,
				"Function unsupported in current mode!\n");

		} else {
			shell_fprintf(shell, SHELL_ERROR, "other error, code: %d\n", ret);
		}
	}
	return 0;
}

static int cmd_off_on(const struct shell *shell, size_t argc, char *argv[])
{
	int ret;

	if (argc == 1) {
		if (get_motor_off_on(relevant_channel)) {
			shell_fprintf(shell, SHELL_NORMAL,
				      "Motor channel %d is turned on!\n", relevant_channel);

		} else {
			shell_fprintf(shell, SHELL_NORMAL,
				      "Motor channel %d is turned off!\n", relevant_channel);
		}

	} else if (argc == 2) {
		if (strcmp(argv[1], "start") == 0) {
			ret = motor_on(FORWARD, relevant_channel);

		} else if (strcmp(argv[1], "stop") == 0) {
			ret = motor_off(relevant_channel);

		} else {
			shell_fprintf(shell, SHELL_ERROR, "Unknown subcommand!\n");
			return 0;
		}

		if (ret != 0) {
			shell_fprintf(shell, SHELL_ERROR,
				"Couldn't change motor state! Error %d\n", ret);

		} else {
			shell_fprintf(shell, SHELL_NORMAL,
				      "Operation executed on channel %d!\n", relevant_channel);
		}

	} else if (argc == 3) {
		if (strcmp(argv[1], "start") == 0) {
			if (strcmp(argv[2], "fwd") == 0 ||
			    strcmp(argv[2], "forward") == 0 ||
			    strcmp(argv[2], "f") == 0) {
				ret = motor_on(FORWARD, relevant_channel);

			} else if (strcmp(argv[2], "bck") == 0 ||
				   strcmp(argv[2], "backward") == 0 ||
				   strcmp(argv[2], "b") == 0) {
				ret = motor_on(BACKWARD, relevant_channel);

			} else {
				shell_fprintf(shell, SHELL_ERROR,
					"Unknown subcommand!, %s\n", argv[2]);
				return 0;
			}

			if (ret != 0) {
				shell_fprintf(shell, SHELL_ERROR,
					"Couldn't change motor state! Error %d\n\n", ret);

			} else {
				shell_fprintf(shell, SHELL_NORMAL, "Operation executed!\n");
			}

		} else {
			shell_fprintf(shell, SHELL_ERROR, "Unknown subcommand!, %s\n", argv[1]);
		}
	}

	return 0;
}

static int cmd_position(const struct shell *shell, size_t argc, char *argv[])
{
	int ret;
	uint32_t position;

	if (argc == 1) {
		ret = position_get(&position, relevant_channel);
		if (ret == SUCCESS) {
			shell_fprintf(shell, SHELL_NORMAL, "Position: %d\n", position);

		} else if (ret == NOT_INITIALISED) {
			shell_fprintf(shell, SHELL_ERROR,
				"Driver not initialised, could't get position!\n");

		} else {
			shell_fprintf(shell, SHELL_ERROR, "Other error, code: %d\n", ret);
		}

		return 0;
	} else if (argc == 2) {
		position = (uint32_t)strtol(argv[1], NULL, 10);
		ret = target_position_set(position, relevant_channel);
		if (ret == SUCCESS) {
			shell_fprintf(shell, SHELL_NORMAL, "Position set to: %d\n", position);

		} else if (ret == NOT_INITIALISED) {
			shell_fprintf(shell, SHELL_ERROR,
				"Driver not initialised, could't set position!\n");

		} else if (ret == DESIRED_VALUE_TO_HIGH) {
			shell_fprintf(shell, SHELL_ERROR,
				"Desired position to high! Desired: %d. Max: 360\n", position);

		} else if (ret == UNSUPPORTED_FUNCTION_IN_CURRENT_MODE) {
			shell_fprintf(shell, SHELL_ERROR,
			"Function unsupported in current mode!\n");

		} else {
			shell_fprintf(shell, SHELL_ERROR, "Other error, code: %d\n", ret);
		}
	}
	return 0;
}

static int cmd_mode(const struct shell *shell, size_t argc, char *argv[])
{
	int ret;
	enum ControlModes mode;

	if (argc == 1) {
		ret = mode_get(&mode);
		if (ret == SUCCESS) {
			char *mode_as_str = "";
			int r = get_control_mode_as_string(mode, &mode_as_str);

			if (r == SUCCESS) {
				shell_fprintf(shell, SHELL_NORMAL, "mode: %s\n", mode_as_str);

			} else {
				shell_fprintf(shell, SHELL_ERROR,
				"Conversion error, code: %d\n", ret);

			}
		} else if (ret == NOT_INITIALISED) {
			shell_fprintf(shell, SHELL_ERROR,
				"driver not initialised, could't get mode!\n");

		} else {
			shell_fprintf(shell, SHELL_ERROR, "other error, code: %d\n", ret);
		}

		return 0;
	} else if (argc == 2) {
		ret = get_control_mode_from_string(argv[1], &mode);
		if (ret != SUCCESS) {
			shell_fprintf(shell, SHELL_ERROR,
				"Setting Control Mode crashed at conversion, errc: %d\n", ret);
		}

		ret = mode_set(mode);
		if (ret == SUCCESS) {
			shell_fprintf(shell, SHELL_NORMAL, "mode set to: %s\n", argv[1]);

		} else if (ret == NOT_INITIALISED) {
			shell_fprintf(shell, SHELL_ERROR,
				"driver not initialised, could't set mode!\n");

		} else {
			shell_fprintf(shell, SHELL_ERROR, "other error, code: %d\n", ret);
		}
	}
	return 0;
}

#if defined(CONFIG_BOARD_NRF52840DONGLE_NRF52840)
static int cmd_boot(const struct shell *shell, size_t argc, char *argv[])
{
	enter_boot();
	return 0;
}
#endif

static int cmd_debug(const struct shell *shell, size_t argc, char *argv[])
{
	shell_fprintf(shell, SHELL_INFO, "Current cycles count: %" PRIu64  "\n"
					 "Time cycles count: %" PRIu64  "\n"
					 "Ret: %d\n"
					 "CalcSpeed: %u\n"
					 "pos target: %u\n"
					 "pos delta %d",
	get_cycles_count_DEBUG(),
	get_time_cycles_count_DEBUG(),
	get_ret_DEBUG(),
	get_calc_speed_DEBUG(),
	get_target_pos_DEBUG(),
	get_pos_d_DEBUG()
	);
	return 0;
}

static int cmd_drv_version(const struct shell *shell, size_t argc, char *argv[])
{
	const struct DriverVersion tmp_ver = get_driver_version();

	shell_fprintf(shell, SHELL_ERROR,
		      "Software version: %d.%d\n", tmp_ver.major, tmp_ver.minor);

	return 0;
}

static int cmd_template_active(const struct shell *shell, size_t argc, char *argv[])
{
	struct Template current;
	int idx = get_current_template(&current);

	if (idx >= 0) {
		shell_fprintf(shell, SHELL_INFO,
			      "Name: %-9s speed %d\n", current.name, current.speed);
	} else {
		shell_fprintf(shell, SHELL_WARNING, "Template not initialized!\n");

	}

	return 0;
}

static int cmd_template_get(const struct shell *shell, size_t argc, char *argv[])
{
	uint8_t size = get_template_size();

	if (argc == 1) {
		struct Template *tmp = (struct Template *)malloc(size * sizeof(struct Template));

		get_templates(tmp);
		for (int i = 0; i < size; i++) {
			shell_fprintf(shell, SHELL_INFO,
				      "Name: %-9s speed %d\n", tmp[i].name, tmp[i].speed);
		}

		free(tmp);
	} else {
		struct Template res;

		get_template_by_name(argv[1], &res);
		shell_fprintf(shell, SHELL_INFO, "speed %d\n", res.speed);
	}

	return 0;
}

static int cmd_template_apply(const struct shell *shell, size_t argc, char *argv[])
{
	uint8_t size = get_template_size();
	struct Template *tmp = (struct Template *)malloc(size * sizeof(struct Template));
	struct Template res;

	get_templates(tmp);
	get_template_by_name(argv[1], &res);

	target_speed_set(res.speed, CH0);
	set_current_template(res.name);

	shell_fprintf(shell, SHELL_ERROR, "Speed template:\n");

	free(tmp);
	return 0;
}

static int cmd_template_set(const struct shell *shell, size_t argc, char *argv[])
{
	struct Template new_template;

	strcpy(new_template.name, argv[1]);
	new_template.speed = (uint32_t)strtol(argv[2], NULL, 10);
	set_template(new_template);
	shell_fprintf(shell, SHELL_INFO, "Done\n");

	return 0;
}

static int cmd_template_clear(const struct shell *shell, size_t argc, char *argv[])
{
	if (argc == 1) {
		int exit_command = factory_reset();

		shell_fprintf(shell, SHELL_INFO,
			      "Template clear exited with command: %d\n", exit_command);
	} else {
		remove_template_by_name(argv[1]);
	}
	return 0;
}

static int cmd_template_size(const struct shell *shell, size_t argc, char *argv[])
{
	int size = get_template_size();

	shell_fprintf(shell, SHELL_ERROR, "Current size of template buffer: %d\n", size);
	return 0;
}

SHELL_CMD_ARG_REGISTER(channel, NULL, "Get/set current relevant channel", cmd_channel, 1, 1);

SHELL_CMD_ARG_REGISTER(speed, NULL,
	"speed in milli RPM (one thousands of RPM)\nspeed to get speed\n speed <val> to set speed",
	cmd_speed, 1, 1);

SHELL_CMD_ARG_REGISTER(motor, NULL, "Start or stop motor\nstart <f b>\noff", cmd_off_on, 1, 2);
SHELL_CMD_ARG_REGISTER(pos, NULL, "----------------------", cmd_position, 1, 1);
SHELL_CMD_ARG_REGISTER(mode, NULL, "----------------------", cmd_mode, 1, 1);
SHELL_CMD_REGISTER(debug, NULL, "get debug info", cmd_debug);
SHELL_CMD_REGISTER(drv_version, NULL, "get motor driver version", cmd_drv_version);

SHELL_STATIC_SUBCMD_SET_CREATE(sub_template,
	SHELL_CMD_ARG(active, NULL, "Active template", cmd_template_active, 1, 0),
	SHELL_CMD_ARG(get, NULL, "get <optional name>", cmd_template_get, 1, 1),
	SHELL_CMD_ARG(apply,   NULL, "apply name", cmd_template_apply, 2, 0),
	SHELL_CMD_ARG(set,   NULL, "set name speed", cmd_template_set, 3, 0),
	SHELL_CMD_ARG(clear,   NULL, "clear template by name. If none given clears all templates.",
				  cmd_template_clear, 1, 1),
	SHELL_CMD_ARG(size,   NULL, "get amount of templates", cmd_template_size, 1, 0),
	SHELL_SUBCMD_SET_END
);

SHELL_CMD_REGISTER(template, &sub_template, "get/apply/create speed template", NULL);


#if defined(CONFIG_BOARD_NRF52840DONGLE_NRF52840)
SHELL_CMD_REGISTER(boot, NULL,
	"Enter bootloader mode, in order to flash new software via nRF connect programmer",
	cmd_boot);
#endif


#endif
```
